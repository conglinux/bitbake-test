## ch07/meta-tutorial/conf/layer.conf
```bitbake
BBPATH .= ":${LAYERDIR}"
BBFILES += "${LAYERDIR}/recipes-*/*/*.bb" 
BBFILE_COLLECTIONS += "tutorial"
BBFILE_PATTERN_tutorial = "^${LAYERDIR}/"
BBFILE_PRIORITY_tutorial = "5"

LAYERSERIES_CORENAMES = "bitbakeguilde"

LAYERVERSION_tutorial = "1"
LAYERSERIES_COMPAT_tutorial = "bitbakeguilde"
```

## test03/meta-tutorial/conf/layer.conf
```bitbake
BBPATH .= ":${LAYERDIR}"
BBFILES += "${LAYERDIR}/recipes-*/*/*.bb" 
BBFILE_COLLECTIONS += "tutorial"
BBFILE_PATTERN_tutorial = "^${LAYERDIR}/"
BBFILE_PRIORITY_tutorial = "5"
LAYERVERSION_tutorial = "1"

LAYERSERIES_CORENAMES = "thud"
LAYERSERIES_COMPAT_tutorial = "thud"
```

## test04/build/conf/bblayers.conf
```bitbake
BBPATH := "${TOPDIR}"
BBFILES ?= ""

LAYERSERIES_CORENAMES ="bitbaketest"
BBLAYERS = " \
  ${TOPDIR}/../meta-test \
  ${TOPDIR}/../meta-two \
"
```

## test04/meta-test/conf/layer.conf
```bitbake
BBPATH .= ":${LAYERDIR}"
BBFILES += "${LAYERDIR}/recipes-*/*/*.bb"

# append layer name to list of configured layers                                                       
BBFILE_COLLECTIONS += "test"                                                                       
# and use name as suffix for other properties                                                          
BBFILE_PATTERN_test = "^${LAYERDIR}/"                                                              
BBFILE_PRIORITY_test = "5"

LAYERVERSION_test ="1"
LAYERSERIES_COMPAT_test ="bitbaketest"
```
